## config/boards/shields/corax56/Kconfig.defconfig
```kconfig
if SHIELD_CORAX56_RIGHT

config ZMK_KEYBOARD_NAME
    default "Corax56R"

endif

if SHIELD_CORAX56_LEFT

config ZMK_KEYBOARD_NAME
    default "Corax56L"

endif
```
