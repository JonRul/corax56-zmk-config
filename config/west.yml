## config/west.yml
```yaml
manifest:
  remotes:
    - name: zmkfirmware
      url-base: https://github.com/zmkfirmware
    - name: petejohanson
      url-base: https://github.com/petejohanson
    - name: urob
      url-base: https://github.com/urob

    # - name: adolto
    #   url-base: https://github.com/adolto

    - name: myrepo
      url-base: https://github.com/JonRul



  projects:
    - name: zmk
      import: app/west.yml
      remote: zmkfirmware
      revision: main

    # own repo
    - name: zmk-driver-ams-as5600
      remote: myrepo
      revision: loc_main
      path: modules/input/zmk-driver-ams-as5600

    # - name: zmk-driver-ams-as5600 # <-- new entry
    #   remote: adolto
    #   revision: main



    # - name: zmk-driver-ams-as5600
    #   path: ${GITHUB_WORKSPACE}/modules/sensor/zmk-driver-ams-as5600
    #   url: .
      
    #   # import: false
    # - name: zmk-driver-ams-as5600
    #   path: modules/sensor/zmk-driver-ams-as5600
    #   remote: myrepo
    #   import: false


    # - name: zmk-studio-messages
    #   path: modules/msgs/zmk-studio-messages
    #   url: https://github.com/zmkfirmware/zmk-studio-messages
    #   revision: main

  self:
    path: config
```
